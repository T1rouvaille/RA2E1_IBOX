## Honcho_PR3/boards/arm/honcho_esl2_llu_pan1780/Kconfig.board
```kconfig
# Copyright (c) 2023 Nordic Semiconductor ASA
# SPDX-License-Identifier: Apache-2.0

config BOARD_HONCHO_ESL2_LLU_PAN1780
	bool "Honcho_ESL2_LLU_PAN1780"
	depends on SOC_NRF52840_QIAA
```

## Honcho_PR3/boards/arm/honcho_esl2_llu_pan1780/Kconfig.defconfig
```kconfig
# Copyright (c) 2023 Nordic Semiconductor ASA
# SPDX-License-Identifier: Apache-2.0

if BOARD_HONCHO_ESL2_LLU_PAN1780

config BOARD
	default "honcho_esl2_llu_pan1780"

config BT_CTLR
   default BT

endif
```

## Honcho_PR3/boards/arm/honcho_pr3_llu_pan1780/Kconfig.board
```kconfig
# Copyright (c) 2023 Nordic Semiconductor ASA
# SPDX-License-Identifier: Apache-2.0

config BOARD_HONCHO_PR3_LLU_PAN1780
	bool "Honcho_PR3_LLU_PAN1780"
	depends on SOC_NRF52840_QIAA
```

## Honcho_PR3/boards/arm/honcho_pr3_llu_pan1780/Kconfig.defconfig
```kconfig
# Copyright (c) 2023 Nordic Semiconductor ASA
# SPDX-License-Identifier: Apache-2.0

if BOARD_HONCHO_PR3_LLU_PAN1780

config BOARD
	default "honcho_pr3_llu_pan1780"

config BT_CTLR
   default BT

endif
```

## Honcho_PR3/build_2/Kconfig/Kconfig.shield
```kconfig
osource "c:/poweredjack/pj_unit/boards/shields/*/Kconfig.shield"
osource "c:/poweredjack/pj_unit_peripheral/boards/shields/*/Kconfig.shield"
osource "c:/firmwareproject/honcho_pr3/boards/shields/*/Kconfig.shield"
osource "C:/ncs/v2.0.0/nrf/boards/shields/*/Kconfig.shield"
```

## Honcho_PR3/build_2/Kconfig/Kconfig.shield.defconfig
```kconfig
osource "c:/poweredjack/pj_unit/boards/shields/*/Kconfig.defconfig"
osource "c:/poweredjack/pj_unit_peripheral/boards/shields/*/Kconfig.defconfig"
osource "c:/firmwareproject/honcho_pr3/boards/shields/*/Kconfig.defconfig"
osource "C:/ncs/v2.0.0/nrf/boards/shields/*/Kconfig.defconfig"
```
